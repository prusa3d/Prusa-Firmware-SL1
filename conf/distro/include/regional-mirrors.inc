## conf/distro/include/regional-mirrors.inc
```bitbake
 
APACHE_MIRROR = "http://archive.apache.org/dist"
DEBIAN_MIRROR = "http://ftp.fi.muni.cz/pub/linux/debian/pool"
GENTOO_MIRROR = "http://ftp.fi.muni.cz/pub/linux/gentoo/distfiles"
GNOME_GIT = "git://git.gnome.org"
GNOME_MIRROR = "ftp://ftp.fau.de/gnome/sources"
GNU_MIRROR = "http://ftp.fi.muni.cz/pub/gnu/gnu"
GNUPG_MIRROR = "https://www.gnupg.org/ftp/gcrypt"
GPE_MIRROR = "http://gpe.linuxtogo.org/download/source"
KERNELORG_MIRROR = "http://cdn.kernel.org/pub"
SOURCEFORGE_MIRROR = "http://10gbps-io.dl.sourceforge.net"
XLIBS_MIRROR = "http://xlibs.freedesktop.org/release"
XORG_MIRROR = "http://ftp.gwdg.de/pub/x11/x.org"
SAVANNAH_GNU_MIRROR = "http://download.savannah.gnu.org/releases"
SAVANNAH_NONGNU_MIRROR = "http://download.savannah.nongnu.org/releases"
CPAN_MIRROR = "http://mirror.dkm.cz/CPAN"
```

## conf/distro/prusa.conf
```bitbake
DISTRO = "prusa"
DISTRO_NAME = "Prusa GNU/Linux distro for 3D printers."
DISTRO_VERSION = "0.9.3-rc4"
DISTRO_CODENAME = "prusix"
SDK_VENDOR = "-prusasdk"
SDK_VERSION :=  "${@'${DISTRO_VERSION}'.replace('+snapshot-${DATE}','')}"
MAINTAINER = "Zavorka <roman.beranek@prusa3d.com>"
TARGET_VENDOR = "-prusa"
LCONF_VERSION = "7"
DISTRO_VERSION[vardepsexclude] = "DATE"
SDK_VERSION[vardepsexclude] = "DATE"

PACKAGE_NO_GCONV = "1"
LOCALE_UTF8_ONLY = "1"
LOCALE_UTF8_IS_DEFAULT = "1"
IMAGE_LINGUAS = "en-us"
ENABLE_BINARY_LOCALE_GENERATION = "1"
GLIBC_GENERATE_LOCALES = "en_US.UTF-8"
GLIBC_SPLIT_LC_PACKAGES = "0"

USER_CLASSES = "buildstats"
SDKMACHINE = "x86_64"

SDK_NAME = "${DISTRO}-${TCLIBC}-${SDK_ARCH}-${IMAGE_BASENAME}-${TUNE_PKGARCH}"
SDKPATH = "/opt/${DISTRO}/${SDK_VERSION}"

DISTRO_FEATURES_append = " \
	alsa ipv6 systemd usbgadget usbhost usrmerge wifi \
	zeroconf ext2 opengl smbfs pam ld-is-gold wayland polkit"
DISTRO_FEATURES_remove = " 3g irda nfc ppp bfs cramfs bluetooth bluez5 \
	ipsec x11 sysvinit ldconfig \
"

# Configure Qt5 flags (GLES is still required for qtdeclarative and qtwebkit)
PACKAGECONFIG_GL_pn-qtbase = "gles2 linuxfb kms eglfs gbm"
#PACKAGECONFIG_FB_pn-qtbase = "directfb"
PACKAGECONFIG_DISTRO_pn-qtbase = "icu examples xkbcommon-evdev accessibility"
PACKAGECONFIG_FONTS_pn-qtbase = "fontconfig"

# compile mesa for swrast_kms support
PACKAGECONFIG_pn-mesa = "gallium gles egl gbm opengl dri"

PACKAGECONFIG_pn-directfb = "drmkms"

# remove python3 dependencies
PACKAGECONFIG_remove_pn-gpgme = "python3"
PACKAGECONFIG_remove_pn-libbytesize = "python3"
PACKAGECONFIG_remove_pn-volume-key = "python3"
PACKAGECONFIG_remove_pn-opkg-utils_class-target = "python"
PACKAGECONFIG_remove_pn-boost = "python"
PACKAGECONFIG_remove_pn-libxml2 = "python"
PACKAGECONFIG_remove_pn-libxml2-native = "python"

EXTRA_OECONF_remove_pn-libsdl = "--disable-video-fbcon"
EXTRA_OECONF_append_pn-libsdl = " --enable-video-fbcon"
EXTRA_OECONF_append_pn-libsdl2 = " --enable-video-kmsdrm"

TCLIBCAPPEND = ""

LICENSE_FLAGS_WHITELIST = "commercial"
OELAYOUT_ABI = "12"

VIRTUAL-RUNTIME_init_manager = "systemd"
DISTRO_FEATURES_BACKFILL_CONSIDERED_append = " sysvinit ldconfig"
VIRTUAL-RUNTIME_initscripts = ""
VIRTUAL-RUNTIME_dev_manager = "systemd"
VIRTUAL-RUNTIME_login_manager = "shadow"
VIRTUAL-RUNTIME_base-utils = "coreutils"

require conf/distro/include/yocto-uninative.inc
INHERIT += "uninative buildstats package_ipk package_tar sstate license remove-libtool"

SDK_INCLUDE_TOOLCHAIN = "1"
SDK_EXT_TYPE = "full"

INSANE_SKIP_qtmultimedia-plugins += "file-rdeps"
INSANE_SKIP_qtbase-plugins += "file-rdeps"
INSANE_SKIP_qtbase += "file-rdeps"
```

## conf/layer.conf
```bitbake
BBPATH .= ":${LAYERDIR}"
BBFILES += "${LAYERDIR}/recipes*/*/*.bb ${LAYERDIR}/recipes*/*/*.bbappend"

BBFILE_COLLECTIONS += "meta-prusa"
BBFILE_PATTERN_meta-prusa := "^${LAYERDIR}/"
BBFILE_PRIORITY_meta-prusa := "^${LAYERDIR}/"
BBFILE_PRIORITY_meta-prusa = "9"
LAYERDEPENDS_meta-prusa = "core openembedded-layer qt5-layer"
LAYERVERSION_meta-prusa = "1"
LAYERSERIES_COMPAT_meta-prusa = "thud"
BBLAYERS_LAYERINDEX_NAME_meta-prusa = "meta-prusa"
```

## conf/machine/lime-a64-mainline.conf
```bitbake
require conf/machine/include/sun50i.inc

KERNEL_DEVICETREE = "allwinner/sun50i-a64-olinuxino.dtb"
UBOOT_MACHINE = "a64-olinuxino_defconfig"

MACHINE_FEATURES += "wifi"
```

## conf/machine/lime-a64-sunxi.conf
```bitbake
require conf/machine/include/sun50i.inc
#require conf/machine/include/sunxi-mali.inc

PREFERRED_PROVIDER_u-boot ?= "u-boot-lime"
PREFERRED_PROVIDER_virtual/bootloader ?= "u-boot-lime"
PREFERRED_VERSION_u-boot-lime = "v2014.07%"

PREFERRED_PROVIDER_virtual/kernel = "linux-a64"
PREFERRED_VERSION_linux-a64 = "3.10%"

UBOOT_LOADADDRESS ?= "0x400080000"
UBOOT_ENTRYPOINT ?= "0x400080000"

KERNEL_DEVICETREE = "allwinner/sun50i-a64-olinuxino.dtb"
UBOOT_MACHINE = "a64-olinuxino_defconfig"
```

## conf/machine/prusa64-sl1.conf
```bitbake
require conf/machine/include/sun50i.inc

PREFERRED_PROVIDER_virtual/libgles1 = "mali-blobs"
PREFERRED_PROVIDER_virtual/libgles2 = "mali-blobs"
PREFERRED_PROVIDER_virtual/egl = "mali-blobs"
PREFERRED_PROVIDER_virtual/mesa = "mali-blobs"
PREFERRED_PROVIDER_virtual/libgbm = "mali-blobs"

KERNEL_MODULE_AUTOLOAD_append = " mali "
MACHINE_ESSENTIAL_EXTRA_RRECOMMENDS += "kernel-module-mali"

PREFERRED_VERSION_u-boot = "v2018.11%"
PREFERRED_VERSION_linux-mainline = "v4.18%"

KERNEL_DEVICETREE = "allwinner/sun50i-a64-prusa64-sl1.dtb"
UBOOT_MACHINE = "prusa64-sl1_defconfig"
```
